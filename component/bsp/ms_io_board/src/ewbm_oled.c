/**
 ******************************************************************************
 * @file    ewbm_oled.c
 * @author  eWBM
 * @version V0.1
 * @date    29-07-2016
 * @brief   OLED module
 ******************************************************************************
 * @attention
 *
 * Copyright(c) 2015 ~ 2020 eWBM Korea , Ltd.
 * All rights reserved.
 * This software contains confidential information of eWBM Korea Co.,Ltd.
 * and unauthorized distribution of this software, or any portion of it, are
 * prohibited.
 *
 ******************************************************************************
 */

#include <stdint.h>
#include <stdlib.h>
#include <string.h>
#include "ewbm_delay.h"

#include "ewbm_gpio.h"
#include "ewbm_oled.h"

#define OLED_DBG_ENABLE
#ifdef OLED_DBG_ENABLE
#include "ewbm_uart.h"
#define OLED_DBG(fmt,args...)        UART_Printf(fmt,##args)
#else
#define OLED_DBG(fmt,args...)
#endif

/** @addtogroup EWBM_Peripheral
  * @{
  */

/** @addtogroup EWBM_OLED
  * @{
  */

/** @defgroup OLED_Internal_Types OLED Intenal Types
  * @{
  */

/**
  * @brief  OLED COMMAND mode definition
  */
#define OLED_CMD    0

/**
  * @brief  OLED DATA mode definition
  */
#define OLED_DAT    1

/**
  * @brief  OLED DC & RES pin number definition
  */
#define OLED_DC     GPIO_PIN_10 //PA10
#define OLED_RES    GPIO_PIN_9  //PB9

/**
  * @brief  Internal global arrangement variable for 12x6 font
  */
static const uint8_t c_chFont1206[95][12] = {
    {0x00,0x00,0x00,0x00,0x00,0x00,0x00,0x00,0x00,0x00,0x00,0x00},  // " ",0
    {0x00,0x00,0x00,0x00,0x3F,0x40,0x00,0x00,0x00,0x00,0x00,0x00},  // "!",1
    {0x00,0x00,0x30,0x00,0x40,0x00,0x30,0x00,0x40,0x00,0x00,0x00},  // """,2
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    {0x40,0x00,0x80,0x00,0x40,0x00,0x20,0x00,0x20,0x00,0x40,0x00},  // "~",94
    };

/**
  * @brief  Internal global arrangement variable for 8x16 font
  */
static const uint8_t c_chFont1608[95][16] = {
    {0x00,0x00,0x00,0x00,0x00,0x00,0x00,0x00,0x00,0x00,0x00,0x00,0x00,0x00,0x00,0x00},  // " ",0
    {0x00,0x00,0x00,0x00,0x00,0x00,0x1F,0xCC,0x00,0x0C,0x00,0x00,0x00,0x00,0x00,0x00},  // "!",1
    {0x00,0x00,0x08,0x00,0x30,0x00,0x60,0x00,0x08,0x00,0x30,0x00,0x60,0x00,0x00,0x00},  // """,2
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    {0x00,0x00,0x60,0x00,0x80,0x00,0x80,0x00,0x40,0x00,0x40,0x00,0x20,0x00,0x20,0x00},  // "~",94
    };

/**
  * @brief  Internal global arrangement variable for 16x16 font
  */
static const uint8_t c_chFont1612[11][32] =
{
    {0x00,0x00,0x3F,0xFC,0x3F,0xFC,0x30,0x0C,0x30,0x0C,0x30,0x0C,0x30,0x0C,0x30,0x0C,0x30,0x0C,0x30,0x0C,0x30,0x0C,0x30,0x0C,0x30,0x0C,0x3F,0xFC,0x3F,0xFC,0x00,0x00},  // "0",0
    {0x00,0x00,0x00,0x00,0x00,0x00,0x00,0x00,0x00,0x00,0x00,0x00,0x00,0x00,0x30,0x00,0x30,0x00,0x3F,0xFC,0x3F,0xFC,0x00,0x00,0x00,0x00,0x00,0x00,0x00,0x00,0x00,0x00},  // "1",1
    {0x00,0x00,0x39,0xFC,0x39,0xFC,0x31,0x8C,0x31,0x8C,0x31,0x8C,0x31,0x8C,0x31,0x8C,0x31,0x8C,0x31,0x8C,0x31,0x8C,0x31,0x8C,0x31,0x8C,0x3F,0x8C,0x3F,0x8C,0x00,0x00},  // "2",2
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    {0x00,0x00,0x00,0x00,0x00,0x00,0x00,0x00,0x00,0x00,0x00,0x00,0x00,0x00,0x18,0x30,0x18,0x30,0x00,0x00,0x00,0x00,0x00,0x00,0x00,0x00,0x00,0x00,0x00,0x00,0x00,0x00},  // ":",10
};

/**
  * @brief  Internal global arrangement variable for 16x32font
  */
static const uint8_t c_chFont3216[11][64] =
{
    {0x00,0x00,0x00,0x00,0x00,0x00,0x00,0x00,0x3F,0xFF,0xFF,0xFC,0x3F,0xFF,0xFF,0xFC,0x30,0x00,0x00,0x0C,0x30,0x00,0x00,0x0C,0x30,0x00,0x00,0x0C,0x30,0x00,0x00,0x0C,  // "0",0
    0x30,0x00,0x00,0x0C,0x30,0x00,0x00,0x0C,0x30,0x00,0x00,0x0C,0x30,0x00,0x00,0x0C,0x3F,0xFF,0xFF,0xFC,0x3F,0xFF,0xFF,0xFC,0x00,0x00,0x00,0x00,0x00,0x00,0x00,0x00},

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    {0x00,0x00,0x00,0x00,0x00,0x00,0x00,0x00,0x00,0x00,0x00,0x00,0x00,0x00,0x00,0x00,0x00,0x00,0x00,0x00,0x0F,0xF0,0x0F,0xF0,0x0F,0xF0,0x0F,0xF0,0x0C,0x30,0x0C,0x30,  // ":",10
    0x0C,0x30,0x0C,0x30,0x0F,0xF0,0x0F,0xF0,0x0F,0xF0,0x0F,0xF0,0x00,0x00,0x00,0x00,0x00,0x00,0x00,0x00,0x00,0x00,0x00,0x00,0x00,0x00,0x00,0x00,0x00,0x00,0x00,0x00}
};

/**
  * @brief  Internal global variable for SPI handle
  */
static tSPI_HANDLE gSpiHandle;
static tGPIO_HANDLE gGpioHandleDC;
static tGPIO_HANDLE gGpioHandleRES;

/**
  * @brief  Internal global arrangement variable for OLED RAM
  */
static uint8_t gDispalyBuffer[OLED_WIDTH][8];

/**
  * @}
  */

/** @addtogroup OLED_Static_Func
  * @{
  */

/** @addtogroup OLED_Static_Func_G1
  * @{
  */

/**
  * @brief  Write data or command to the OLED module
  * @param  data: Writing data
  * @param  type: Command or data
  * @retval Pointer to base address
  */
static void write_byte(uint8_t data, uint8_t type)
{
    if(type == OLED_DAT) {
        GPIO_WritePin(&gGpioHandleDC, OLED_DC, SET);
    } else {
        GPIO_WritePin(&gGpioHandleDC, OLED_DC, RESET);
    }
    SPI_Write(&gSpiHandle, data);
}

/**
  * @}
  */

/**
  * @}
  */

/** @addtogroup OLED_External_Func
  * @{
  */

/** @addtogroup OLED_External_Func_G1
  *  @brief    Initialization and Deinitialization functions
  * @{
  */

/**
  * @brief  Initialize the OLED module and clear
  * @retval  If success, return EWBMOK value
  */
int OLED_Init()
{
    int ret;
    gSpiHandle.bank = SPI_BANK_1;
    ret = SPI_Init(&gSpiHandle);

    gSpiHandle.dataFormat = SPI_DSS_08_BIT_DATA;
    SPI_DataSize(&gSpiHandle);

    gGpioHandleDC.bank = GPIO_BANK_1;
    GPIO_Init(&gGpioHandleDC);

    gGpioHandleRES.bank = GPIO_BANK_2;
    GPIO_Init(&gGpioHandleRES);

    GPIO_SetDir(&gGpioHandleDC, OLED_DC, 0, SET);
    GPIO_SetDir(&gGpioHandleRES, OLED_RES, 0, SET);

    GPIO_WritePin(&gGpioHandleRES, OLED_RES, SET);
    GPIO_WritePin(&gGpioHandleDC, OLED_DC, RESET);

    write_byte(0xAE, OLED_CMD);  // Turn off oled panel
    write_byte(0x00, OLED_CMD);  // Set low column address
    write_byte(0x10, OLED_CMD);  // Set high column address
    write_byte(0x40, OLED_CMD);  // Set start line address  Set Mapping RAM Display Start Line (0x00~0x3F)
    write_byte(0x81, OLED_CMD);  // Set contrast control register
    write_byte(0xCF, OLED_CMD);  // Set SEG Output Current Brightness
    write_byte(0xA1, OLED_CMD);  // Set SEG/Column Mapping
    write_byte(0xC0, OLED_CMD);  // Set COM/Row Scan Direction
    write_byte(0xA6, OLED_CMD);  // Set normal display
    write_byte(0xA8, OLED_CMD);  // Set multiplex ratio(1 to 64)
    write_byte(0x3f, OLED_CMD);  // 1/64 duty
    write_byte(0xD3, OLED_CMD);  // Set display offset Shift Mapping RAM Counter (0x00~0x3F)
    write_byte(0x00, OLED_CMD);  // Not offset
    write_byte(0xd5, OLED_CMD);  // Set display clock divide ratio/oscillator frequency
    write_byte(0x80, OLED_CMD);  // Set divide ratio, Set Clock as 100 Frames/Sec
    write_byte(0xD9, OLED_CMD);  // Set pre-charge period
    write_byte(0xF1, OLED_CMD);  // Set Pre-Charge as 15 Clocks & Discharge as 1 Clock
    write_byte(0xDA, OLED_CMD);  // Set com pins hardware configuration
    write_byte(0x12, OLED_CMD);  // (Common signal pad configuration)
    write_byte(0xDB, OLED_CMD);  // Set vcomh
    write_byte(0x40, OLED_CMD);  // Set VCOM Deselect Level
    write_byte(0x20, OLED_CMD);  // Set Page Addressing Mode (0x00/0x01/0x02)
    write_byte(0x02, OLED_CMD);  // (0x02)
    write_byte(0x8D, OLED_CMD);  // Set Charge Pump enable/disable
    write_byte(0x14, OLED_CMD);  // Set(0x10) disable
    write_byte(0xA4, OLED_CMD);  // Disable Entire Display On (0xa4/0xa5)
    write_byte(0xA6, OLED_CMD);  // Disable Inverse Display On (0xa6/a7)
    write_byte(0xAF, OLED_CMD);  // Turn on oled panel

    OLED_ClearScreen(0);
    OLED_Invalidate();

    return ret;
}

/**
  * @brief  Deinitialize the OLED module
  * @retval  If success, return EWBMOK value
  */
int OLED_DeInit()
{
    int ret;
    ret = SPI_DeInit(&gSpiHandle);
    memset(&gSpiHandle, 0x00, sizeof(gSpiHandle));
    return ret;
}

/**
  * @}
  */

/** @addtogroup OLED_External_Func_G2
  *  @brief    Operation functions
  * @{
  */

/**
  * @brief  Turn OLED display on
  */
void OLED_DisplayOn()
{
    write_byte(0x8D, OLED_CMD);
    write_byte(0x14, OLED_CMD);
    write_byte(0xAF, OLED_CMD);
}

/**
  * @brief  Turn OLED display off
  */
void OLED_DisplayOff()
{
    write_byte(0x8D, OLED_CMD);
    write_byte(0x10, OLED_CMD);
    write_byte(0xAE, OLED_CMD);
}

/**
  * @brief  Turn entire display mode on
  */
void OLED_EntireDisplayOn()
{
    write_byte(0xA5, OLED_CMD);
}

/**
  * @brief  Turn entire display mode off
  */
void OLED_EntireDisplayOff()
{
    write_byte(0xA4, OLED_CMD);
}

/**
  * @brief  Set contrast for the OLED module
  * @param  contrast: contrast value
  */
void OLED_SetContrast(uint32_t contrast)
{
    write_byte(0x81, OLED_CMD);
    write_byte(contrast, OLED_CMD);
}

/**
  * @brief  Reverse color mode on
  */
void OLED_ReverseColorOn()
{
    write_byte(0xA7, OLED_CMD);
}

/**
  * @brief  Reverse color mode off
  */
void OLED_ReverseColorOff()
{
    write_byte(0xA6, OLED_CMD);
}

/**
  * @brief  Flip OLED display horizontally
  */
void OLED_FlipModeOn()
{
    write_byte(0xA0, OLED_CMD);
}

/**
  * @brief  Restore fliped OLED display
  */
void OLED_FlipModeOff()
{
    write_byte(0xA1, OLED_CMD);
}

/**
  * @brief  Redraw OLED display
  */
void OLED_Invalidate()
{
    uint8_t i, j;
    for(i = 0; i < 8; i++) {
        write_byte(0xB0+i, OLED_CMD);
        write_byte(0x02, OLED_CMD);
        write_byte(0x10, OLED_CMD);
        for(j = 0; j < OLED_WIDTH; j++) {
            write_byte(gDispalyBuffer[j][i], OLED_DAT);
        }
    }
}

/**
  * @brief  Draw dots from start coordinates to end coordinates
  * @param  posX1: Start X-coordinate
  * @param  posY1: Start Y-coordinate
  * @param  posX2: End X-coordinate
  * @param  posY2: End Y-coordinate
  * @param  dot: Color of dot
  */
void OLED_Fill_Screen(uint8_t posX1, uint8_t posY1, uint8_t posX2, uint8_t posY2, eOLED_COLOR dot)
{
    uint8_t posX, posY;

    for(posX = posX1; posX <= posX2; posX++) {
        for(posY = posY1; posY <= posY2; posY++) {
            OLED_DrawPoint(posX, posY, dot);
        }
    }
}

/**
  * @brief  Clear entire OLED display with vertical 8pixel value
  * @param  fill: Vertical 8pixel value
  */
void OLED_ClearScreen(uint8_t fill)
{
    uint8_t i, j;

    for(i = 0; i < 8; i++) {
        write_byte(0xB0+i, OLED_CMD);
        write_byte(0x02, OLED_CMD);
        write_byte(0x10, OLED_CMD);
        for(j = 0; j < OLED_WIDTH; j++) {
            gDispalyBuffer[j][i] = fill;
        }
    }
}

/**
  * @brief  Draw a dot with x,y coordinates
  * @param  posX: X-coordinate
  * @param  posY: Y-coordinate
  * @param  point: Color of dot
  */
void OLED_DrawPoint(uint8_t posX, int8_t posY, eOLED_COLOR point)
{
    uint8_t chPos, chBx, chTemp = 0;

    if(posX > 127 || posY > 63 || posY < 0) {
        return;
    }
    chPos = 7-posY/8;
    chBx = posY%8;
    chTemp = 1<<(7-chBx);

    if(point) {
        gDispalyBuffer[posX][chPos] |= chTemp;
    } else {
        gDispalyBuffer[posX][chPos] &= ~chTemp;
    }
}

/**
  * @brief  Draw a character with x,y coordinates and font, color
  * @param  posX: X-coordinate
  * @param  posY: Y-coordinate
  * @param  chr: A Character
  * @param  font: Font type
  * @param  color: Color type
  */
void OLED_DisplayChar(uint8_t posX, int8_t posY, uint8_t chr, eOLED_FONT font, eOLED_COLOR color)
{
    uint8_t i, j;
    uint8_t chTemp;
    int16_t posY0 = posY;

    chr = chr-' ';
    for(i = 0; i < font; i++) {
        if(font == OLED_FONT_12) {
            if(color) {
                chTemp = c_chFont1206[chr][i];
            } else {
                chTemp = ~c_chFont1206[chr][i];
            }
        } else {
            if(color) {
                chTemp = c_chFont1608[chr][i];
            } else {
                chTemp = ~c_chFont1608[chr][i];
            }
        }

        for(j = 0; j < 8; j++) {
            if(chTemp & 0x80) {
                OLED_DrawPoint(posX, posY, OLED_COLOR_BLUE);
            } else {
                OLED_DrawPoint(posX, posY, OLED_COLOR_BLACK);
            }
            chTemp <<= 1;
            posY++;

            if((posY-posY0) == font) {
                posY = posY0;
                posX++;
                break;
            }
        }
    }
}

/**
  * @brief  Draw string with x,y coordinates and font, color
  * @param  posX: X-coordinate
  * @param  posY: Y-coordinate
  * @param  str: Pointer to string
  * @param  font: Font type
  * @param  color: Color type
  * @param  align: Align with last line
  */
void OLED_DisplayString(uint8_t posX, int8_t posY, const uint8_t* str, eOLED_FONT font, eOLED_COLOR color, eOLED_ALIGN align)
{
    while(*str != '\0') {
        if(posX > (OLED_WIDTH-(font/2))) {
            posX = 0;
            posY += font;
#ifdef __ENABLE_SDIO_S__
            OLED_Invalidate();
#endif
        }
        if(align == OLED_ALIGN_ON && posY > OLED_HEIGHT-font) {
#ifdef __ENABLE_SDIO_S__
            posX = 0;
            posY = 0;
            OLED_ClearScreen(0);
#else
            break;
#endif
        }
        OLED_DisplayChar(posX, posY, *str, font, color);
        posX += font/2;
        str++;
    }
}

/**
  * @brief  Draw a bitmap with x,y coordinates and width, height
  * @param  posX: X-coordinate
  * @param  posY: Y-coordinate
  * @param  bmp: Pointer to bmp data
  * @param  width: Width of bitmap
  * @param  height: Height of bitmap
  */
void OLED_DrawBitmap(uint8_t posX, uint8_t posY, const uint8_t* bmp, uint8_t width, uint8_t height)
{
    uint16_t i, j, byteWidth = (width+7)/8;

    for(j = 0; j < height; j++) {
        for(i = 0; i < width; i++ ) {
            if(*(bmp+j * byteWidth+i/8) & (OLED_WIDTH >> (i & 7))) {
                OLED_DrawPoint(posX+i, posY+j, OLED_COLOR_BLUE);
            }
        }
    }
}

/**
  * @brief  Draw 16x16 font number charater with x,y coordinates and color
  * @param  posX: X-coordinate
  * @param  posY: Y-coordinate
  * @param  chr: Number character
  * @param  color: Color type
  */
void OLED_Draw1616Num(uint8_t posX, uint8_t posY, uint8_t chr, eOLED_COLOR color)
{
    uint8_t i, j;
    uint8_t chTemp = 0, posY0 = posY, chMode = 0;

    for(i = 0; i < 32; i++) {
        if(color) {
            chTemp = c_chFont1612[chr-0x30][i];
        } else {
            chTemp = ~c_chFont1612[chr-0x30][i];
        }
        for(j = 0; j < 8; j++) {
            chMode = chTemp & 0x80? 1 : 0;
            OLED_DrawPoint(posX, (int8_t)posY, (eOLED_COLOR)chMode);
            chTemp <<= 1;
            posY++;
            if((posY-posY0) == 16) {
                posY = posY0;
                posX++;
                break;
            }
        }
    }
}

/**
  * @brief  Draw 16x32 font number character with x,y coordinates and color
  * @param  posX: X-coordinate
  * @param  posY: Y-coordinate
  * @param  chr: Number character
  * @param  color: Color type
  */
void OLED_Draw3216Num(uint8_t posX, uint8_t posY, uint8_t chr, eOLED_COLOR color)
{
    uint8_t i, j;
    uint8_t chTemp = 0, posY0 = posY, chMode = 0;

    for(i = 0; i < 64; i++) {
        if(color) {
            chTemp = c_chFont3216[chr-0x30][i];
        } else {
            chTemp = ~c_chFont3216[chr-0x30][i];
        }
        for(j = 0; j < 8; j++) {
            chMode = chTemp & 0x80? 1 : 0;
            OLED_DrawPoint(posX, (int8_t)posY, (eOLED_COLOR)chMode);
            chTemp <<= 1;
            posY++;
            if((posY-posY0) == 32) {
                posY = posY0;
                posX++;
                break;
            }
        }
    }
}
/**
  * @}
  */

/**
  * @}
  */

/**
  * @}
  */

/**
  * @}
  */

